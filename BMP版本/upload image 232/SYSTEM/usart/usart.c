#include "sys.h"
#include "usart.h"	
////////////////////////////////////////////////////////////////////////////////// 	 
//如果使用ucos,则包括下面的头文件即可.
#if SYSTEM_SUPPORT_UCOS
#include "includes.h"					//ucos 使用	  
#endif

////////////////////////////////////////////////////////////////////////////////////////////
// 文   件   名  : CassSysVar.h
// 版        本  :                            
// 目的及主要功能: CRC校验码的存放数组存声明，在内部RAM较小的CPU中可以考虑存放在Flash中
// 创 建 日  期  : 2008.3.5
// 修 改 日  期  : 2008.3.5                    
// 作        者  : hfl
// 修   改   者  :                      
////////////////////////////////////////////////////////////////////////////////////////////
/* CRC高位字节值表*/ 
const u8 CRCHi[256] = { 

0x00, 0xC1, 0x81, 0x40, 0x01, 0xC0, 0x80, 0x41, 0x01, 0xC0, 

0x80, 0x41, 0x00, 0xC1, 0x81, 0x40, 0x01, 0xC0, 0x80, 0x41, 
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0x80, 0x41, 0x00, 0xC1, 0x81, 0x40 

};


/* CRC低位字节值表*/ 
const u8 CRCLo[256] = { 

0x00, 0xC0, 0xC1, 0x01, 0xC3, 0x03, 0x02, 0xC2, 0xC6, 0x06, 

0x07, 0xC7, 0x05, 0xC5, 0xC4, 0x04, 0xCC, 0x0C, 0x0D, 0xCD, 
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0x43, 0x83, 0x41, 0x81, 0x80, 0x40 

};

#define USART_REC_LEN 64
#define USART_REC_TIME_COUNT 10
#define USART_SND_LEN 1024  //76800 + modbus format

u8 ComDelayCount = USART_REC_TIME_COUNT;
u8 ComInBuf[USART_REC_LEN];
//u8 ComOutBuf[USART_SND_LEN];
extern u8 ComOutBuf[USART_SND_LEN];
u8 *pComInBuf = ComInBuf;
u8 *pComOutBuf = ComOutBuf;

u16 ComInDataLen = 0;
//u8 ComInDataPos = 0;
u32 ComOutDataLen = 0;
u32 ComOutDataPos = 0;

extern u16 cass_mv_boarder_width;
extern u16 cass_mv_boarder_height;

extern u8 raw_data[];
extern u8 out_data[];
extern u8 CassMem[];
extern u8 sensor_id;
extern u8 update_outbuf_flag;

void USART1_IRQHandler(void)
{
	//接收中断 
	if(USART1->SR&(1<<5))//接收到数据
	{	 
		if(ComInDataLen < USART_REC_LEN)
		{
			pComInBuf[ComInDataLen] = USART1->DR; 
			ComInDataLen++;
			ComDelayCount = USART_REC_TIME_COUNT;
		}
	}
	//发送中断
		if(USART1->SR&(1<<7))//可以发送下一个数据
		{	 
			if(ComOutDataPos < ComOutDataLen)
			{
				USART1->DR=pComOutBuf[ComOutDataPos];
				ComOutDataPos++;	
			}
			else
			{
				USART1->CR1 &= 0xffffff7f;
				USART1->SR &= 0xffffffBf;
			}
		}
} 



void memcpy(u8 *str,u8 *copystr,u32 len)
{
  u32 i;
  for(i = 0;i < len;i++)
    str[i] = copystr[i];
}


//用于得到相应的CRC校验码，不需修改
u16 GetCRC(u8 *Array,u8 DataCount )
{
	u8 index;
	u8 i;
	u8 CRCHigh,CRCLow ;

	//Array为数组首地址,DataCount为数据长度

	CRCHigh = 0xFF;
	CRCLow = 0xFF;

	for(i=0; i<DataCount; i+=1 )
	{
		index = CRCHigh ^ ( *(Array + i) );
		CRCHigh = CRCLow ^ CRCHi[index];
		CRCLow = CRCLo[index];
	}

	return ( CRCHigh << 8 ) | CRCLow ;
}


//======================================================================
// 函 数 名： COMFrmVrify
// 功能描述： 接受帧校验
// 输入参数： 待校验的数组首地址，长度
// 输出参数： 1为校验正确，0校验失败
// 创建日期： 2007.6.18
// 修改日期： 2008.3.5
// 作    者： john
// 修 改 者:  hfl  
// 附加说明： 
//======================================================================
u8 COMFrmVrify(u8 *Array, u8 DataCount)
{
	u16 verify,temp;

	//校验码 CRC校验
	verify = GetCRC(Array,DataCount - 2 ) ;

	temp =  Array[DataCount - 1] | (Array[DataCount - 2] << 8);
	if ( verify == temp ) 	return 1;
	else return 0 ;
}



void UartSendData()
{
	 ComOutDataPos = 0;
	 USART1->CR1 |= 1<<7; //重新使能发送中断
}


//======================================================================
// 函 数 名： UartSlaveDataHandle
// 功能描述： 串口主机接受帧函数
// 输入参数： void
// 输出参数： void
// 创建日期： 2007.6.18
// 修改日期： 2008.3.5
// 作    者： john
// 修 改 者:  hfl  
// 附加说明： 通过全局指针交换数据
//======================================================================
void UartRecvDataHandle() //标准MOD-BUD
{
	u16 usTemp ;
	u16 tmp ;

	tmp = pComInBuf[3]  + (pComInBuf[2]<< 8)  ;  //内存地址
	//根据接收帧构造发送帧并启动发送
	pComOutBuf[0]=pComInBuf[0] ; //sensor_id
	pComOutBuf[1]=pComInBuf[1] ;
	if ( pComInBuf[1] == 0x03 ) // 上位机发的读数据命令
	{	
		usTemp = pComInBuf[5]<<1; //字节个数
		pComOutBuf[2] = usTemp;
		memcpy(pComOutBuf+3, tmp+ CassMem ,usTemp ) ;
		ComOutDataLen =usTemp + 5 ;
	}
	else if (pComInBuf[1] == 0x06)	//写命令
	{
		//usTemp = pComInBuf[5]<<1; //字节个数
		memcpy(tmp+ CassMem, pComInBuf+ 4, 2) ; //数据拷贝到内存区
		memcpy(pComOutBuf,pComInBuf,8) ;
		ComOutDataLen = 8 ;
		
	}
	else if ( pComInBuf[1] == 0x10 )
	{
		usTemp = pComInBuf[6];//字节个数
		memcpy(tmp+ CassMem, pComInBuf+ 7, usTemp ) ; //数据拷贝到内存区
		memcpy(pComOutBuf,pComInBuf,6) ;
		ComOutDataLen = 8 ;
	}
	else if ( pComInBuf[1] == 0x20 )
	{
		if(tmp > BMP_IMAGE_SIZE/UART_SND_BLK_DATA_SIZE)
				return;
		
		if(tmp == 0)
			 update_outbuf_flag = 0;
		memcpy((u8 *)&usTemp, (u8 *)(out_data+tmp*UART_SND_BLK_SIZE+4),2);
		usTemp+=8;
		memcpy(pComOutBuf, (u8 *)(out_data+tmp*UART_SND_BLK_SIZE), usTemp);
		if(usTemp != UART_SND_BLK_SIZE)
			update_outbuf_flag = 1;
		ComOutDataLen = usTemp;
		
		return;
	}
	
	usTemp = GetCRC(pComOutBuf,ComOutDataLen - 2 ) ;
	pComOutBuf[ComOutDataLen - 1] = usTemp ;			//返回帧尾
	pComOutBuf[ComOutDataLen - 2] = usTemp >> 8 ;
} 

//======================================================================
// 函 数 名： UART0RecvHandle
// 功能描述： 串口处理接受帧函数
// 输入参数： ComNo:串口号
// 输出参数： void
// 创建日期： 2007.6.18
// 修改日期： 2008.3.5
// 作    者： john
// 修 改 者:  hfl  
// 附加说明： 通过全局指针交换数据
//======================================================================
void UartRecvHandle(u8 ComNo)
{
	u8 crcFlag;
	
	if(pComInBuf[0] == sensor_id)
	{
		//crcFlag = COMFrmVrify(pComInBuf, ComInDataLen) ; //
		ComInDataLen = 0; //为下次接收作准备
		ComOutDataLen = 0;
		UartRecvDataHandle() ;
		UartSendData();//启动发送过程,需修改为具体代码
	}
}

//初始化IO 串口1
//pclk2:PCLK2时钟频率(Mhz)
//bound:波特率
//CHECK OK
//091209
void uart_init(u32 pclk2,u32 bound)
{  	 
	float temp;
	u16 mantissa;
	u16 fraction;	   
	temp=(float)(pclk2*1000000)/(bound*16);//得到USARTDIV
	mantissa=temp;				 //得到整数部分
	fraction=(temp-mantissa)*16; //得到小数部分	 
    mantissa<<=4;
	mantissa+=fraction; 
	RCC->APB2ENR|=1<<2;   //使能PORTA口时钟  
	RCC->APB2ENR|=1<<14;  //使能串口时钟 
	GPIOA->CRH&=0XFFFFF00F;//IO状态设置
	GPIOA->CRH|=0X000008B0;//IO状态设置
		  
	RCC->APB2RSTR|=1<<14;   //复位串口1
	RCC->APB2RSTR&=~(1<<14);//停止复位	   	   
	//波特率设置
 	USART1->BRR=mantissa; // 波特率设置	 
	USART1->CR1|=0X200C;  //1位停止,无校验位.

	//使能接收中断
	USART1->CR1|=1<<8;    //PE中断使能
	USART1->CR1|=1<<5;    //接收缓冲区非空中断使能	    	
	
	//USART1->CR1|=1<<7;    
	USART1->CR1|=1<<7;    //TXE发送缓冲区空中断使能	
	
	MY_NVIC_Init(3,3,USART1_IRQChannel,2);//组2，最低优先级 
}
